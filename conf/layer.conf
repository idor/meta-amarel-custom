## conf/layer.conf
```bitbake
# We have a conf and classes directory, add to BBPATH
BBPATH .= ":${LAYERDIR}"

# We have recipes-* directories, add to BBFILES
BBFILES += "${LAYERDIR}/recipes-*/*/*.bb \
	${LAYERDIR}/recipes-*/*/*.bbappend"




BBFILE_COLLECTIONS += "amarel-custom"
BBFILE_PATTERN_amarel-custom = "^${LAYERDIR}/"
BBFILE_PRIORITY_amarel-custom = "12"
IMAGE_INSTALL_append = " linux-firmware-usb8897"
IMAGE_ROOTFS_EXTRA_SPACE = "2097152"
KERNEL_MODULE_AUTOLOAD += "ads7846"
IMAGE_INSTALL_append = " hostapd dnsmasq iproute2"
IMAGE_INSTALL_remove = " msc-wallpaper"
IMAGE_INSTALL_remove = " connman"
IMAGE_INSTALL_append = " cronie mysql5"
IMAGE_INSTALL_append = " python-argparse"
IMAGE_INSTALL_append = " python-json python-requests python-email python-urllib3 python-pybluez"
#DISTRO_FEATURES_remove += " x11"
PACKAGECONFIG_DISTRO_append_pn-qtbase = " accessibility"
DISTRO_FEATURES_append = " bluetooth bluez5 "
#In order to build them you need to enable "oracle-java" license
LICENSE_FLAGS_WHITELIST += "oracle_java"

IMAGE_INSTALL_append += " mariadb"
IMAGE_INSTALL_append += " ppp sudo ethtool e2fsprogs"
IMAGE_INSTALL_append += " networkmanager networkmanager-qt modemmanager polkit consolekit quectel-ppp nano file memtester stress tcpdump minicom openssl gpioscript iptables i2c-tools mtd-utils-ubifs mtd-utils-misc resolvconf "
IMAGE_INSTALL_append += " ntp"
IMAGE_INSTALL_append += " apt"


# User configuration should be placed below this line
CORE_IMAGE_EXTRA_INSTALL += "oracle-jse-jre"

# Fonts and languages
# English, Spanish, Portuguese, Chinese, French, Italian
GLIBC_GENERATE_LOCALES = " \
    en_GB.UTF-8 \
    en_US.UTF-8 \
    es_ES.UTF-8 \
    fr_FR.UTF-8 \
    it_IT.UTF-8 \
    pt_BR.UTF-8 \
    pt_PT.UTF-8 \
    zh_CN.UTF-8 \
"
```
